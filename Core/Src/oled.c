#include "oled.h"
#include "i2c.h"
#include <stdio.h>
#include <stdarg.h>
#include <string.h>

#define OLED_ADDR    (0x3C << 1)   /* SSD1306 I2C 地址 */
#define OLED_CMD     0x00
#define OLED_DATA    0x40

/* 6x8 ASCII 字体 ' ' ~ '~' */
static const uint8_t font6x8[][6] = {
    {0x00,0x00,0x00,0x00,0x00,0x00}, /* sp */
    {0x00,0x00,0x5F,0x00,0x00,0x00}, /* ! */
    {0x00,0x07,0x00,0x07,0x00,0x00}, /* " */
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    {0x08,0x04,0x08,0x10,0x08,0x00}, /* ~ */
};

static void oled_write_cmd(uint8_t cmd)
{
    /* Mem_Write: 第一字节 0x00(CMD) → 寄存器地址, cmd → 数据 */
    HAL_I2C_Mem_Write(&hi2c2, OLED_ADDR, 0x00, I2C_MEMADD_SIZE_8BIT,
                      &cmd, 1, 10);
}

static void oled_write_data(uint8_t *data, uint16_t len)
{
    /* Mem_Write: 第一字节 0x40(DATA) → 寄存器地址, data → 连续数据 */
    HAL_I2C_Mem_Write(&hi2c2, OLED_ADDR, 0x40, I2C_MEMADD_SIZE_8BIT,
                      data, len, 100);
}

void OLED_Init(void)
{
    HAL_Delay(20);  /* 等 OLED 上电稳定 */

    oled_write_cmd(0xAE);  /* 关闭显示 */
    oled_write_cmd(0xD5);  /* 时钟分频 */
    oled_write_cmd(0x80);
    oled_write_cmd(0xA8);  /* 多路复用 */
    oled_write_cmd(0x3F);  /* 64 行 */
    oled_write_cmd(0xD3);  /* 显示偏移 */
    oled_write_cmd(0x00);
    oled_write_cmd(0x40);  /* 起始行 */
    oled_write_cmd(0x8D);  /* 电荷泵 */
    oled_write_cmd(0x14);
    oled_write_cmd(0x20);  /* 内存寻址模式 */
    oled_write_cmd(0x00);  /* 水平模式 */
    oled_write_cmd(0xA1);  /* 段重映射 */
    oled_write_cmd(0xC8);  /* COM 扫描方向 */
    oled_write_cmd(0xDA);  /* COM 引脚 */
    oled_write_cmd(0x12);
    oled_write_cmd(0x81);  /* 对比度 */
    oled_write_cmd(0xCF);
    oled_write_cmd(0xD9);  /* 预充电 */
    oled_write_cmd(0xF1);
    oled_write_cmd(0xDB);  /* VCOM */
    oled_write_cmd(0x40);
    oled_write_cmd(0xA4);  /* 全屏显示关闭 */
    oled_write_cmd(0xA6);  /* 正常显示 */
    oled_write_cmd(0xAF);  /* 开启显示 */
}

void OLED_Clear(void)
{
    uint8_t i, zero[128] = {0};
    for (i = 0; i < 8; i++) {
        oled_write_cmd(0xB0 + i);
        oled_write_cmd(0x00);
        oled_write_cmd(0x10);
        oled_write_data(zero, 128);
    }
}

void OLED_ShowChar(uint8_t x, uint8_t y, char ch)
{
    if (x > OLED_WIDTH - 6 || y > 7) return;
    if (ch < ' ' || ch > '~') ch = ' ';

    oled_write_cmd(0xB0 + y);
    oled_write_cmd(0x00 + (x & 0x0F));
    oled_write_cmd(0x10 + (x >> 4));

    oled_write_data((uint8_t *)font6x8[ch - ' '], 6);
}

void OLED_ShowString(uint8_t x, uint8_t y, const char *str)
{
    while (*str) {
        OLED_ShowChar(x, y, *str++);
        x += 6;
        if (x > OLED_WIDTH - 6) { x = 0; y++; }
    }
}

void OLED_ShowNum(uint8_t x, uint8_t y, int32_t num, uint8_t len)
{
    char buf[12];
    int8_t i;
    for (i = len - 1; i >= 0; i--) {
        buf[i] = '0' + (num % 10);
        num /= 10;
    }
    buf[len] = '\0';
    OLED_ShowString(x, y, buf);
}

void OLED_ShowFloat(uint8_t x, uint8_t y, float num,
                    uint8_t intLen, uint8_t decLen)
{
    char buf[32];
    int32_t intPart = (int32_t)num;
    float frac = num - (float)intPart;
    if (frac < 0) frac = -frac;
    for (uint8_t i = 0; i < decLen; i++) frac *= 10.0f;
    int32_t decPart = (int32_t)(frac + 0.5f);
    snprintf(buf, sizeof(buf), "%*ld.%0*ld", (int)intLen, (long)intPart,
             (int)decLen, (long)decPart);
    OLED_ShowString(x, y, buf);
}

void OLED_Printf(uint8_t x, uint8_t y, const char *fmt, ...)
{
    char buf[48];
    va_list args;
    va_start(args, fmt);
    vsnprintf(buf, sizeof(buf), fmt, args);
    va_end(args);
    OLED_ShowString(x, y, buf);
}
